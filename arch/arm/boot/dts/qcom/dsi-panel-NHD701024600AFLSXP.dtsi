&mdss_mdp {
    dsi_sciaps_nhd_70in: qcom,mdss_dsi_sciaps_nhd_70in {
			// 665 Mbs -> 166.25 -> 55.4
            qcom,mdss-dsi-panel-name = "Newhaven 7.0\" 1024x600 LVDS  video mode panel v1.0";
            qcom,mdss-dsi-panel-controller = <&mdss_dsi0>;
            qcom,mdss-dsi-panel-type = "dsi_video_mode";
            qcom,mdss-dsi-panel-destination = "display_1";
            qcom,mdss-dsi-panel-framerate = <130>;
            qcom,mdss-dsi-virtual-channel-id = <0>;
            qcom,mdss-dsi-stream = <0>;
            qcom,mdss-dsi-panel-width = <1024>;
            qcom,mdss-dsi-panel-height = <600>;
            qcom,mdss-dsi-h-back-porch = <160>;
            qcom,mdss-dsi-h-front-porch = <128>;
            qcom,mdss-dsi-h-pulse-width = <32>;
            qcom,mdss-dsi-h-sync-skew = <0>;
            qcom,mdss-dsi-v-back-porch = <23>;
            qcom,mdss-dsi-v-front-porch = <8>;
            qcom,mdss-dsi-v-pulse-width = <4>;
            qcom,mdss-dsi-h-left-border = <0>;
            qcom,mdss-dsi-h-right-border = <0>;
            qcom,mdss-dsi-v-top-border = <0>;
            qcom,mdss-dsi-v-bottom-border = <0>;
			qcom,mdss-dsi-bpp = <24>;
            qcom,mdss-dsi-underflow-color = <0xff>;
            qcom,mdss-dsi-border-color = <0>;
			qcom,mdss-dsi-on-command-state = "dsi_lp_mode";
			//qcom,mdss-dsi-off-command-state = "dsi_hs_mode";
			qcom,mdss-dsi-off-command-state = "dsi_lp_mode";
            qcom,mdss-dsi-h-sync-pulse = <1>;
            qcom,mdss-dsi-traffic-mode = "non_burst_sync_pulse";
            qcom,mdss-dsi-bllp-eof-power-mode;
            qcom,mdss-dsi-bllp-power-mode;
            qcom,mdss-dsi-lane-0-state;
            qcom,mdss-dsi-lane-1-state;
            qcom,mdss-dsi-lane-2-state;
            qcom,mdss-dsi-lane-3-state;
            qcom,mdss-dsi-force-clock-lane-hs;
            qcom,mdss-dsi-panel-timings = [B4 28 1C 00 54 58 20 2C 20 03 04 00];
            qcom,mdss-dsi-t-clk-post = <3>;
            qcom,mdss-dsi-t-clk-pre = <35>;
            qcom,mdss-dsi-dma-trigger = "trigger_sw";
            qcom,mdss-dsi-mdp-trigger = "none";
            qcom,mdss-dsi-bl-pmic-control-type = "bl_ctrl_pwm";
            //qcom,mdss-dsi-bl-pmic-pwm-frequency = <7575>; //PWM period in microseconds
            //qcom,mdss-dsi-bl-pmic-pwm-frequency = <50>; //50 us -> 20 kHz
            //qcom,mdss-dsi-bl-pmic-pwm-frequency = <10>; //10 us -> 100 kHz
            //qcom,mdss-dsi-bl-pmic-pwm-frequency = <11>; //11 us -> ~90.9 kHz
            qcom,mdss-dsi-bl-pmic-pwm-frequency = <20>; //20 us -> 50 kHz
            //qcom,mdss-dsi-bl-pmic-pwm-frequency = <200>; //200 us -> 5 kHz
            qcom,mdss-dsi-bl-pmic-bank-select = <0>;
            qcom,mdss-dsi-pwm-gpio = <&pm8916_mpps 4 0>;
            //qcom,mdss-dsi-reset-sequence = <1 10>;
			qcom,mdss-pan-physical-width-dimension = <155>;
            qcom,mdss-pan-physical-height-dimension = <87>;

			// HALO Alert!!!
			// Enabling qcom,mdss-dsi-always-on or pulling LCD_RST line low causing the white screen and HALO!!!
			//qcom,mdss-dsi-always-on;  // Causes the white sreeen that results in halo!

			// SN65DSI84 DSI-to-LVDS bridge doesn't support command mode.
			// Send them anyway but with no delays
			qcom,mdss-dsi-on-command = [
							//
				05 01 00 00 00 00 01 11		// exit_sleep_mode	- sleep 120(H'78) ms
				05 01 00 00 00 00 01 29		// set_display_on	- sleep optinal 16(H'10) ms
			];
			qcom,mdss-dsi-off-command = [
				05 01 00 00 00 00 01 28		// set_display_off	- sleep optinal 16(H'10) ms
                05 01 00 00 00 00 01 10		// enter_sleep_mode	- sleep optinal 16(H'10) ms
			];
    };
};
