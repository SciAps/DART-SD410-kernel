/* Copyright (c) 2015, The Linux Foundation. All rights reserved.
 *
 * This program is free software; you can redistribute it and/or modify
 * it under the terms of the GNU General Public License version 2 and
 * only version 2 as published by the Free Software Foundation.
 *
 * This program is distributed in the hope that it will be useful,
 * but WITHOUT ANY WARRANTY; without even the implied warranty of
 * MERCHANTABILITY or FITNESS FOR A PARTICULAR PURPOSE.  See the
 * GNU General Public License for more details.
 */

#include "apq8016-var-sd410-sciaps-ngx.dtsi"

&spi_1 {
	status = "ok";

	ketek_dpp3@0 {
		compatible = "ketek,dpp3";
		reg = <0>;
		spi-max-frequency = <12000000>;
		spi-cpha = <0>;
		spi-cpol = <0>;
		status = "ok";
	};
};

